## west.yml
```yaml
# Copyright (c) 2021 Nordic Semiconductor ASA
# SPDX-License-Identifier: Apache-2.0

manifest:
  remotes:
    - name: myfork
      url-base: https://github.com/manmountain

  projects:
    # TODO: Once west supports sparse checkout, we should use it here.
    - name: nrfxlib
      remote: myfork
      repo-path: sdk-nrfxlib
      revision: ad0529d028ec3ba6b8283bcc76e546912f39f378
```
